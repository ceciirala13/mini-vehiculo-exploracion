## Software/GUI Integrada/esp32c6_bridge/sdkconfig.defaults
```kconfig
# Target architecture
CONFIG_IDF_TARGET="esp32c6"

# Wi-Fi SoftAP Support
CONFIG_ESP_WIFI_SOFTAP_SUPPORT=y

# FreeRTOS and Task configurations
CONFIG_FREERTOS_HZ=1000
CONFIG_ESP_MAIN_TASK_STACK_SIZE=4096

# LWIP Sockets & TCP configurations
CONFIG_LWIP_MAX_SOCKETS=10
CONFIG_LWIP_SO_RCVBUF=y
CONFIG_LWIP_TCP_SND_BUF_DEFAULT=8192
CONFIG_LWIP_TCP_WND_DEFAULT=8192
```

## Software/Integrado Completo/References/uart_txrx_comm/main/Kconfig.projbuild
```kconfig
menu "Example Configuration"

    orsource "$IDF_PATH/examples/common_components/env_caps/$IDF_TARGET/Kconfig.env_caps"

    config EXAMPLE_UART_BAUD_RATE
        int "UART communication speed"
        range 1200 115200
        default 115200
        help
            UART communication speed for the example.

    config EXAMPLE_UART_RXD
        int "UART RXD pin number"
        range ENV_GPIO_RANGE_MIN ENV_GPIO_IN_RANGE_MAX
        default 16
        help
            GPIO number for UART RX pin (ESP32 default: GPIO 16).

    config EXAMPLE_UART_TXD
        int "UART TXD pin number"
        range ENV_GPIO_RANGE_MIN ENV_GPIO_OUT_RANGE_MAX
        default 17
        help
            GPIO number for UART TX pin (ESP32 default: GPIO 17).

    config EXAMPLE_TASK_STACK_SIZE
        int "Example task stack size"
        range 1024 16384
        default 3072
        help
            Defines stack size for UART TX and RX tasks. Insufficient stack size can cause crash.

endmenu
```

## Software/Integrado Completo/References/uart_txrx_comm/sdkconfig.defaults
```kconfig
CONFIG_IDF_TARGET="esp32"
CONFIG_EXAMPLE_UART_BAUD_RATE=115200
CONFIG_EXAMPLE_UART_TXD=17
CONFIG_EXAMPLE_UART_RXD=16
CONFIG_EXAMPLE_TASK_STACK_SIZE=3072
```

## Software/Integrado Completo/References/uart_txrx_control/main/Kconfig.projbuild
```kconfig
menu "Example Configuration"

    orsource "$IDF_PATH/examples/common_components/env_caps/$IDF_TARGET/Kconfig.env_caps"

    config EXAMPLE_UART_BAUD_RATE
        int "UART communication speed"
        range 1200 115200
        default 115200
        help
            UART communication speed for the example.

    config EXAMPLE_UART_RXD
        int "UART RXD pin number"
        range ENV_GPIO_RANGE_MIN ENV_GPIO_IN_RANGE_MAX
        default 44
        help
            GPIO number for UART RX pin (ESP32-S3: GPIO 44 / RXD0, module pin 36).

    config EXAMPLE_UART_TXD
        int "UART TXD pin number"
        range ENV_GPIO_RANGE_MIN ENV_GPIO_OUT_RANGE_MAX
        default 43
        help
            GPIO number for UART TX pin (ESP32-S3: GPIO 43 / TXD0, module pin 37).

    config EXAMPLE_TASK_STACK_SIZE
        int "Example task stack size"
        range 1024 16384
        default 3072
        help
            Defines stack size for UART TX and RX tasks. Insufficient stack size can cause crash.

endmenu
```
